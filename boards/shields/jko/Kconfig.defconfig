## boards/shields/jko/Kconfig.defconfig
```kconfig
if SHIELD_JKO_LEFT

config ZMK_KEYBOARD_NAME
    default "JKO"

config ZMK_SPLIT_ROLE_CENTRAL
    default y

endif

if SHIELD_JKO_LEFT || SHIELD_JKO_RIGHT

config ZMK_SPLIT
    default y

endif
```

## boards/shields/jko/Kconfig.shield
```kconfig
config SHIELD_JKO_LEFT
    def_bool $(shields_list_contains,jko_left)

config SHIELD_JKO_RIGHT
    def_bool $(shields_list_contains,jko_right)
```

## boards/shields/microdox/Kconfig.defconfig
```kconfig
# Copyright (c) 2020 The ZMK Contributors
# SPDX-License-Identifier: MIT

if SHIELD_MICRODOX_LEFT

config ZMK_KEYBOARD_NAME
    default "Microdox"

config ZMK_SPLIT_ROLE_CENTRAL
    default y

endif

if SHIELD_MICRODOX_LEFT || SHIELD_MICRODOX_RIGHT 

config ZMK_SPLIT
    default y

endif
```
